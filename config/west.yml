## config/west.yml
```yaml
manifest:
  remotes:
    - name: zmkfirmware
      url-base: https://github.com/zmkfirmware
    - name: m165437 # nice-view-gem
      url-base: https://github.com/M165437 # nice-view-gem
  projects:
    - name: zmk
      remote: zmkfirmware
      revision: v0.3
      import: app/west.yml
    - name: nice-view-gem # nice-view-gem
      remote: m165437 # nice-view-gem
      revision: v0.3 # nice-view-gem
  self:
    path: config
```
